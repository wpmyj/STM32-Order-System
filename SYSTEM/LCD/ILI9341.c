#include "ILI9341.h"
                                        
/*
	画笔颜色,背景颜色
*/
u16 POINT_COLOR = 0x0000, BACK_COLOR = WHITE;	//0xFFFF;  

/*
	管理LCD重要参数	
*/
_lcd_dev LCDDEV;

/*
	函数功能：LCD写数据
	参数：u16 data :要写入的数据
	说明：这个函数直接用宏定义了，刷屏速度快一点，因此屏蔽了这个函数
*/
//void LCD_WR_DATA(u16 data)
//{	
//	DATA_OUT();
//	LCD_RS=1;  //RS=1;
//	LCD_CS=0;	//CS=0;
//	DataOut(data);				
//	LCD_WR=0;	//WR=0;
//	LCD_WR=1;	//WR=1;
//	LCD_CS=1;	//CS=1;	
//	DATA_IN();
//}

/*
	函数功能：写寄存器函数
	参数：u16 data ：要写入寄存器的地址
	说明：这个函数直接用宏定义了，刷屏速度快一点，因此屏蔽了这个函数
*/
//void LCD_WR_REG(u16 data)
//{ 
//	DATA_OUT();
//	LCD_RS=0;	//RS=0;
//	LCD_CS=0;	//CS=0;	
//	DataOut(data);
//	LCD_WR=0;	//WR=0;
//	LCD_WR=1;	//WR=1;
//	LCD_CS=1;	//CS=1;		
//	DATA_IN();
//}

/*
	函数功能：写寄存器
	参数：u8 LCD_Reg:：写入寄存器的地址
				u16 LCD_RegValue：写入寄存器的数据
*/
void LCD_WriteReg(u8 LCD_Reg, u16 LCD_RegValue)
{        
	LCD_WR_REG(LCD_Reg);  
	LCD_WR_DATA(LCD_RegValue);                             
}         

/*
	函数功能：开始写GRAM
*/
void LCD_WriteRAM_Prepare(void)
{
  LCD_WR_REG(0x2C);
} 

/*
	函数功能：LCD写GRAM
*/
void LCD_WriteRAM(u16 RGB_Code)
{                                                            
  LCD_WR_DATA(RGB_Code);	//写十六位GRAM
}

/*
	函数功能：读LCD数据
	返回值:读到的值
*/
u16 LCD_RD_DATA(void)
{				
	DATA_IN();
	return DataIn;		 
}	

/*
	函数功能：读寄存器
	参数：u8 LCD_Reg:寄存器地址
	返回值:读到的数据
*/
u16 LCD_ReadReg(u8 LCD_Reg)
{										   
	LCD_WR_REG(LCD_Reg);		//写入要读的寄存器序号
	Delay_us(5);		  
	return LCD_RD_DATA();		//返回读到的值
}  

/*
	函数功能：当mdk -O1时间优化时需要设置延时i
	参数：u8 i 延时参数
*/
void opt_delay(u8 i)
{
	while(i--);
}

/*
	函数功能：读取个某点的颜色值	 
	参数：u16x,u16y:坐标
	返回值:此点的颜色
*/
u16 LCD_ReadPoint(u16 x,u16 y)
{
 	u16 r=0,g=0,b=0;
	if(x>=LCDDEV.width||y>=LCDDEV.height) return 0;	//超过了范围,直接返回		   
	LCD_SetCursor(x,y);	    
	LCD_WR_REG(0X2E);							//9341发送读GRAM指令
	if(DataIn)	r=0;							//dummy Read	   
	opt_delay(2);	  
 	r = DataIn;  		  					//实际坐标颜色
	opt_delay(2);	  
	b = DataIn; 
	g = r&0XFF;										//对于9341,第一次读取的是RG的值,R在前,G在后,各占8位
	g <<= 8;
	return (((r>>11)<<11)|((g>>10)<<5)|(b>>11));	//ILI9341需要公式转换一下
}

/*
	函数功能：转换RGB格式
	参数：	u16 c:GBR格式的颜色值
	返回值：RGB格式的颜色值
	说明：  从ILI93xx读出的数据为GBR格式，而我们写入的时候为RGB格式。
				  通过该函数转换
*/
u16 LCD_BGR2RGB(u16 c)
{
	u16  r,g,b,rgb;   
	b=(c>>0)&0x1f;
	g=(c>>5)&0x3f;
	r=(c>>11)&0x1f;         
	rgb=(b<<11)+(g<<5)+(r<<0);                 
	return(rgb);
}                 

/*
	函数功能：LCD开启显示ILI9341
*/
void LCD_DisplayOn(void)
{                                           
  LCD_WR_REG(0X29); 	//26万色显示开启
} 

/*
	函数功能：LCD关闭显示ILI9341
*/
void LCD_DisplayOff(void)
{           
  LCD_WR_REG(0X28);		//关闭显示 
}   

/*
	函数功能：设置光标位置
	参数：u16 Xpos:横坐标
				u16 Ypos:纵坐标
*/
void LCD_SetCursor(u16 Xpos, u16 Ypos)
{
	Xpos += 10;
	Ypos += 72;
	LCD_WR_REG(0X2A); 
	LCD_WR_DATA(Xpos>>8); 
	LCD_WR_DATA(Xpos&0XFF);         
	LCD_WR_REG(0X2B); 
	LCD_WR_DATA(Ypos>>8); 
	LCD_WR_DATA(Ypos&0XFF);
}  

/*
	函数功能：画点
	参数：u16 x:0~219
				u16 y:0~171
*/
void LCD_DrawPoint(u16 x,u16 y)
{
	LCD_SetCursor(x,y);//设置光标位置 
	LCD_WR_REG(0X2C);//开始写入GRAM
	LCD_WR_DATA(POINT_COLOR); 
}          

/*
	函数功能：画点带颜色
	参数：u16x,u16y:坐标
				u16 color:点的颜色
*/
void LCD_DrawPoint_color(u16 x,u16 y,u16 color)
{
	LCD_SetCursor(x,y);		//设置光标位置 
	LCD_WriteRAM_Prepare();	//开始写入GRAM
	LCD_WR_DATA(color); 
}

/*
	函数功能：快速画点
	参数：u16 x:0~219
			  u16 y:0~171
				u16 color:颜色
*/
void LCD_Fast_DrawPoint(u16 x,u16 y,u16 color)
{                    
	LCD_WR_REG(0x2A); 
	LCD_WR_DATA(x>>8); 
	LCD_WR_DATA(x&0XFF);         
	LCD_WR_REG(0x2B); 
	LCD_WR_DATA(y>>8); 
	LCD_WR_DATA(y&0XFF);
					 
	LCD_WR_REG(0X2C);//开始写入GRAM
	LCD_WR_DATA(color); 
}  


/*
	函数功能：设置LCD的自动扫描方向
	说明：注意:其他函数可能会受到此函数设置的影响
				所以,一般设置为L2R_U2D即可,如果设置为其他扫描方式,可能导致显示不正常.
	参数：u8 dir:0~7,代表8个方向(具体定义见lcd.h)   
*/
void LCD_Scan_Dir(u8 dir)
{
	u16 regval=0;
	u8 dirreg=0;
	u16 temp;  
	if(LCDDEV.dir==1){			   
		switch(dir){//方向转换
			case 0 : dir=6; break;
			case 1 : dir=7; break;
			case 2 : dir=4; break;
			case 3 : dir=5; break;
			case 4 : dir=1; break;
			case 5 : dir=0; break;
			case 6 : dir=3; break;
			case 7 : dir=2; break;	     
		}
	}
		switch(dir){
			case L2R_U2D://从左到右,从上到下
				regval|=(0<<7)|(0<<6)|(0<<5); 
				break;
			case L2R_D2U://从左到右,从下到上
				regval|=(1<<7)|(0<<6)|(0<<5); 
				break;
			case R2L_U2D://从右到左,从上到下
				regval|=(0<<7)|(1<<6)|(0<<5); 
				break;
			case R2L_D2U://从右到左,从下到上
				regval|=(1<<7)|(1<<6)|(0<<5); 
				break;	 
			case U2D_L2R://从上到下,从左到右
				regval|=(0<<7)|(0<<6)|(1<<5); 
				break;
			case U2D_R2L://从上到下,从右到左
				regval|=(0<<7)|(1<<6)|(1<<5); 
				break;
			case D2U_L2R://从下到上,从左到右
				regval|=(1<<7)|(0<<6)|(1<<5); 
				break;
			case D2U_R2L://从下到上,从右到左
				regval|=(1<<7)|(1<<6)|(1<<5); 
				break;	 
		}
		dirreg=0X36;
 		regval|=0X08;//BGR   
		LCD_WriteReg(dirreg,regval);
 		if((regval&0X20)||LCDDEV.dir==1){
			if(LCDDEV.width<LCDDEV.height){	//交换X,Y
				temp=LCDDEV.width;
				LCDDEV.width=LCDDEV.height;
				LCDDEV.height=temp;
 			}
		}else{
			if(LCDDEV.width>LCDDEV.height){//交换X,Y
				temp=LCDDEV.width;
				LCDDEV.width=LCDDEV.height;
				LCDDEV.height=temp;
 			}
		}  
		LCD_WR_REG(LCDDEV.setxcmd); 
		LCD_WR_DATA(0);
		LCD_WR_DATA(0);
		LCD_WR_DATA((LCDDEV.width-1)>>8);
		LCD_WR_DATA((LCDDEV.width-1)&0XFF);
		
		LCD_WR_REG(LCDDEV.setycmd); 
		LCD_WR_DATA(0);LCD_WR_DATA(0);
		LCD_WR_DATA((LCDDEV.height-1)>>8);LCD_WR_DATA((LCDDEV.height-1)&0XFF);  
		LCD_WriteReg(dirreg,regval);
}

/*
	函数功能：设置LCD显示方向
	参数：u8 dir:0,竖屏；1,横屏
*/
void LCD_Display_Dir(u8 dir)
{
	if(dir==0){			//竖屏
		LCDDEV.dir=0;	//竖屏
		LCDDEV.width=LCDWIDTH;
		LCDDEV.height=LCDHEIGHT;
		LCDDEV.wramcmd=0X2C;
	 	LCDDEV.setxcmd=0X2A;
		LCDDEV.setycmd=0X2B;  	 
	}else{ 					//横屏			
		LCDDEV.dir=1;	//横屏
		LCDDEV.width=LCDHEIGHT;
		LCDDEV.height=LCDWIDTH;
		LCDDEV.wramcmd=0X2C;
	 	LCDDEV.setxcmd=0X2A;
		LCDDEV.setycmd=0X2B;  	 
	} 
	LCD_Scan_Dir(DFT_SCAN_DIR);	//默认扫描方向
}	

/*
	函数功能：LCD初始化 芯片ili9341
	硬件连接：LCD_BL ：	PA3
						LCD_CS ：	PC9
						LCD_RS ： PC8           
						LCD_WR ： PC7
						LCD_RD ： PC6
						DataOut： PB_All
*/
void LCD_Init(void)
{ 
	GPIO_InitTypeDef  GPIO_InitStructure;
	/*开启PA PB PC AFIO时钟*/		
	RCC_APB2PeriphClockCmd(RCC_APB2Periph_GPIOA | RCC_APB2Periph_GPIOB | RCC_APB2Periph_GPIOC | RCC_APB2Periph_AFIO, ENABLE);
	/*关闭jtag接口*/
	GPIO_PinRemapConfig(GPIO_Remap_SWJ_JTAGDisable , ENABLE);
//	/*配置相关端口PB数据口，为了实现屏幕能读能写，按键能正常工作，屏蔽了这段，用宏定义了输入输出*/
//	GPIO_InitStructure.GPIO_Pin = GPIO_Pin_All;
//	GPIO_InitStructure.GPIO_Speed = GPIO_Speed_50MHz;
//	GPIO_InitStructure.GPIO_Mode = GPIO_Mode_Out_PP;
//	GPIO_Init(GPIOB, &GPIO_InitStructure);                                                       
	GPIO_Write(GPIOB,0XFF);
	/*配置LCD_RD,LCD_WR,LCD_RS,LCD_CS端口*/
	GPIO_InitStructure.GPIO_Pin = GPIO_Pin_6|GPIO_Pin_7|GPIO_Pin_8|GPIO_Pin_9;
	GPIO_InitStructure.GPIO_Mode = GPIO_Mode_Out_PP;        
	GPIO_InitStructure.GPIO_Speed = GPIO_Speed_50MHz;
	GPIO_Init(GPIOC, &GPIO_InitStructure);
	GPIO_SetBits(GPIOC, GPIO_Pin_6|GPIO_Pin_7|GPIO_Pin_8|GPIO_Pin_9); 
	/*配置LCD_BL背光端口*/
	GPIO_InitStructure.GPIO_Pin =GPIO_Pin_3;
	GPIO_InitStructure.GPIO_Mode = GPIO_Mode_Out_PP;   
	GPIO_InitStructure.GPIO_Speed = GPIO_Speed_50MHz;
	GPIO_Init(GPIOA, &GPIO_InitStructure);
	GPIO_SetBits(GPIOA, GPIO_Pin_3);                                                                                                                             
	/************************Start initial sequence***************************/
	LCD_WR_REG(0xCF);      
	LCD_WR_DATA(0x00); 
	LCD_WR_DATA(0xC1); 
	LCD_WR_DATA(0X30);
	
	LCD_WR_REG(0xED);  
	LCD_WR_DATA(0x64); 
	LCD_WR_DATA(0x03); 
	LCD_WR_DATA(0X12); 
	LCD_WR_DATA(0X81);
	
	LCD_WR_REG(0xE8);  
	LCD_WR_DATA(0x85); 
	LCD_WR_DATA(0x10); //00
	LCD_WR_DATA(0x7A);
	
	LCD_WR_REG(0xCB);  
	LCD_WR_DATA(0x39); 
	LCD_WR_DATA(0x2C); 
	LCD_WR_DATA(0x00); 
	LCD_WR_DATA(0x34); 
	LCD_WR_DATA(0x02);
	
	LCD_WR_REG(0xF7);  
	LCD_WR_DATA(0x20);
	
	LCD_WR_REG(0xEA);  
	LCD_WR_DATA(0x00); 
	LCD_WR_DATA(0x00);
	
	LCD_WR_REG(0xC0);    //Power control 
	LCD_WR_DATA(0x1B);   //VRH[5:0] 
	
	LCD_WR_REG(0xC1);    //Power control 
	LCD_WR_DATA(0x01);   //SAP[2:0];BT[3:0] 	
	
	LCD_WR_REG(0xC5);    //VCM control 
	LCD_WR_DATA(0x30); 	 //3F
	LCD_WR_DATA(0x30); 	 //3C	
	
	LCD_WR_REG(0xC7);    //VCM control2 
	LCD_WR_DATA(0XB7); 
	
	LCD_WR_REG(0x36);    // Memory Access Control 
	LCD_WR_DATA(0x48); 
	
	LCD_WR_REG(0x3A);   
	LCD_WR_DATA(0x55); 	
	
	LCD_WR_REG(0xB1);   
	LCD_WR_DATA(0x00);   
	LCD_WR_DATA(0x1A); 	
	
	LCD_WR_REG(0xB6);    // Display Function Control 
	LCD_WR_DATA(0x0A); 
	LCD_WR_DATA(0xA2); 
	
	LCD_WR_REG(0xF2);    // 3Gamma Function Disable 
	LCD_WR_DATA(0x00); 
	
	LCD_WR_REG(0x26);    //Gamma curve selected 
	LCD_WR_DATA(0x01); 	
	
	LCD_WR_REG(0xE0);    //Set Gamma 
	LCD_WR_DATA(0x0F); 
	LCD_WR_DATA(0x2A); 
	LCD_WR_DATA(0x28); 
	LCD_WR_DATA(0x08); 
	LCD_WR_DATA(0x0E); 
	LCD_WR_DATA(0x08); 
	LCD_WR_DATA(0x54); 
	LCD_WR_DATA(0XA9); 
	LCD_WR_DATA(0x43); 
	LCD_WR_DATA(0x0A); 
	LCD_WR_DATA(0x0F); 
	LCD_WR_DATA(0x00); 
	LCD_WR_DATA(0x00); 
	LCD_WR_DATA(0x00); 
	LCD_WR_DATA(0x00); 	
	
	LCD_WR_REG(0XE1);    //Set Gamma 
	LCD_WR_DATA(0x00); 
	LCD_WR_DATA(0x15); 
	LCD_WR_DATA(0x17); 
	LCD_WR_DATA(0x07); 
	LCD_WR_DATA(0x11); 
	LCD_WR_DATA(0x06); 
	LCD_WR_DATA(0x2B); 
	LCD_WR_DATA(0x56); 
	LCD_WR_DATA(0x3C); 
	LCD_WR_DATA(0x05); 
	LCD_WR_DATA(0x10); 
	LCD_WR_DATA(0x0F); 
	LCD_WR_DATA(0x3F); 
	LCD_WR_DATA(0x3F); 
	LCD_WR_DATA(0x0F); 	
	
	LCD_WR_REG(0x2B); 
	LCD_WR_DATA(0x00);
	LCD_WR_DATA(0x00);
	LCD_WR_DATA(0x01);
	LCD_WR_DATA(0x3f);
	
	LCD_WR_REG(0x2A); 
	LCD_WR_DATA(0x00);
	LCD_WR_DATA(0x00);
	LCD_WR_DATA(0x00);
	LCD_WR_DATA(0xef);	

	LCD_WR_REG(0x11); //Exit Sleep
	Delay_ms(120);
	LCD_WR_REG(0x29); //display on	

	LCD_Display_Dir(0);		 	//默认为横屏
	LCD_BL = 1;							//点亮LCD背光
	LCD_Clear(WHITE);
}


/*********************************************************************************************************

     下面的函数属于算法部分-不限平台--与硬件无关--只要是块显示屏-下面的函数就能直接调用

**********************************************************************************************************/
/*
	函数功能：清屏函数
	参数：u16 color:要清屏的填充色
*/
void LCD_Clear(u16 color)
{
	u32 index=0;      
	u32 totalpoint=LCDDEV.width;
	totalpoint*=LCDDEV.height; 			//得到总点数
	LCD_SetCursor(0x00,0x0000);	//设置光标位置 
	LCD_WriteRAM_Prepare();     		//开始写入GRAM	 	  
	for(index=0;index<totalpoint;index++){
		LCD_WR_DATA(color);	   
	}
}  

/*
	函数功能：在指定区域内填充单个颜色
	说明：(sx,sy),(ex,ey):填充矩形对角坐标,区域大小为:(ex-sx+1)*(ey-sy+1)   
	参数：u16 color:要填充的颜色
*/
void LCD_Fill(u16 sx,u16 sy,u16 ex,u16 ey,u16 color)
{          
	u16 i,j;
	u16 xlen=0;
	xlen=ex-sx+1;	 
	for(i=sy;i<=ey;i++){
		LCD_SetCursor(sx,i);      				//设置光标位置 
		LCD_WriteRAM_Prepare();     			//开始写入GRAM	  
		for(j=0;j<xlen;j++)
			LCD_WR_DATA(color);	//设置光标位置 	    
	}	 
} 


/*
	函数功能：在指定区域内填充指定颜色块			 
	说明：(sx,sy),(ex,ey):填充矩形对角坐标,区域大小为:(ex-sx+1)*(ey-sy+1)   
	参数：u16 *color:要填充的颜色
*/
void LCD_Color_Fill(u16 sx,u16 sy,u16 ex,u16 ey,u16 *color)
{  
	u16 height,width;
	u16 i,j;
	width=ex-sx+1; 			//得到填充的宽度
	height=ey-sy+1;			//高度
 	for(i=0;i<height;i++){
 		LCD_SetCursor(sx,sy+i);   	//设置光标位置 
		LCD_WriteRAM_Prepare();     //开始写入GRAM
		for(j=0;j<width;j++)
			LCD_WR_DATA(color[i*height+j]);//写入数据 
	}	  
}  


/*
	函数功能：画线
	参数：u16 x1,u16 y1:起点坐标
				u16 x2,u16 y2:终点坐标
*/
void LCD_DrawLine(u16 x1, u16 y1, u16 x2, u16 y2)
{
	u16 t; 
	int xerr=0,yerr=0,delta_x,delta_y,distance; 
	int incx,incy,uRow,uCol; 
	delta_x=x2-x1; //计算坐标增量 
	delta_y=y2-y1; 
	uRow=x1; 
	uCol=y1; 
	if(delta_x>0)incx=1; //设置单步方向 
	else if(delta_x==0)incx=0;//垂直线 
	else {incx=-1;delta_x=-delta_x;} 
	if(delta_y>0)incy=1; 
	else if(delta_y==0)incy=0;//水平线 
	else{incy=-1;delta_y=-delta_y;} 
	if( delta_x>delta_y)distance=delta_x; //选取基本增量坐标轴 
	else distance=delta_y; 
	for(t=0;t<=distance+1;t++ )//画线输出 
	{  
		LCD_DrawPoint(uRow,uCol);//画点 
		xerr+=delta_x ; 
		yerr+=delta_y ; 
		if(xerr>distance) 
		{ 
			xerr-=distance; 
			uRow+=incx; 
		} 
		if(yerr>distance) 
		{ 
			yerr-=distance; 
			uCol+=incy; 
		} 
	}  
}  

/*
	函数功能：画矩形
	参数：(x1,y1),(x2,y2):矩形的对角坐标
*/
void LCD_DrawRectangle(u16 x1, u16 y1, u16 x2, u16 y2)
{
	LCD_DrawLine(x1,y1,x2,y1);
	LCD_DrawLine(x1,y1,x1,y2);
	LCD_DrawLine(x1,y2,x2,y2);
	LCD_DrawLine(x2,y1,x2,y2);
}


/*
	函数功能：在指定位置画一个指定大小的圆
	参数：(u16 x, u16 y):中心点
					u16 r :半径
*/
void Draw_Circle(u16 x0,u16 y0,u8 r,u16 color)
{
	int a,b;
	int di;
	POINT_COLOR = color;		//画点颜色
	a=0;b=r;	  
	di=3-(r<<1);             //判断下个点位置的标志
	while(a<=b){
		LCD_DrawPoint(x0+a,y0-b);             //5
 		LCD_DrawPoint(x0+b,y0-a);             //0   
		LCD_DrawPoint(x0+b,y0+a);             //4               
		LCD_DrawPoint(x0+a,y0+b);             //6 
		LCD_DrawPoint(x0-a,y0+b);             //1       
 		LCD_DrawPoint(x0-b,y0+a);             
		LCD_DrawPoint(x0-a,y0-b);             //2             
  	LCD_DrawPoint(x0-b,y0-a);             //7     
		a++;
		//使用Bresenham算法画圆     
		if(di<0)
			di +=4*a+6;	  
		else{
			di+=10+4*(a-b);   
			b--;
		} 						    
	}
} 	


/*
	函数功能：在指定位置显示一个字符
	参数：u16 x, u16y:起始坐标
				u8 num:要显示的字符:" "--->"~"
				u8 size:字体大小 12/16
				u8 mode:叠加方式(1)还是非叠加方式(0)
*/
void LCD_ShowChar(u16 x,u16 y,u8 num,u8 size,u8 mode)
{  							  
  u8 temp,t1,t;
	u16 y0=y;
	u16 colortemp=POINT_COLOR;      			     
	//设置窗口		   
	num = num - ' ';								//得到偏移后的值
	if(!mode){ 											//非叠加方式
		for(t=0;t<size;t++){   
			if(size==12)
				temp = ASCII_12[num][t];  //调用1206字体
			else
				temp = ASCII_16[num][t];	//调用1608字体 	                          
			for(t1=0;t1<8;t1++){			    
				if(temp&0x80)
					POINT_COLOR = colortemp;
				else
					POINT_COLOR = BACK_COLOR;
				LCD_DrawPoint(x,y);	
				temp <<= 1;
				y ++;
				if(x>=LCDDEV.width){			//超区域了
					POINT_COLOR=colortemp;
					return;
				}
				if((y-y0)==size){
					y = y0;
					x ++;
					if(x>=LCDDEV.width){//超区域了
						POINT_COLOR = colortemp;
						return;
					}
					break;
				}
			}  	 
		}    
	}else{//叠加方式
		for(t=0;t<size;t++){ 
			if(size==12)
				temp = ASCII_12[num][t];  		//调用1206字体
			else
				temp = ASCII_16[num][t];		 	//调用1608字体 	                          
			for(t1=0;t1<8;t1++){			    
				if(temp&0x80)
					LCD_DrawPoint(x,y); 
				temp <<= 1;
				y ++;
				if(x>=LCDDEV.height){					//超区域了
					POINT_COLOR = colortemp;
					return;
				}
				if((y-y0)==size){
					y = y0;
					x ++;
					if(x>=LCDDEV.width){				//超区域了
						POINT_COLOR = colortemp;
						return;
					}
					break;
				}
			}  	 
		}     
	}
	POINT_COLOR=colortemp;	    	   	 	  
} 

/*
	函数功能：m^n函数
	返回值:m^n次方.
*/
u32 LCD_Pow(u8 m,u8 n)
{
	u32 result=1;	 
	while(n--){
		result *= m;
	}    
	return result;
}		


/*
	函数功能：显示数字,高位为0,则不显示
	参数：u16 x,u16 y :起点坐标	 
				u8 len :数字的位数
				u8 size:字体大小
			  u32 num:数值(0~4294967295);	 
*/
void LCD_ShowNum(u16 x,u16 y,u32 num,u8 len,u8 size)
{         	
	u8 t,temp;
	u8 enshow=0;						   
	for(t=0;t<len;t++){
		temp=(num/LCD_Pow(10,len-t-1))%10;
		if(enshow==0&&t<(len-1)){
			if(temp==0){
				LCD_ShowChar(x+(size/2)*t,y,' ',size,0);
				continue;
			}else
				enshow=1; 
		}
	 	LCD_ShowChar(x+(size/2)*t,y,temp+'0',size,0); 
	}
} 


/*
	函数功能：显示数字,高位为0,还是显示
	参数：u16 x,u16 y:起点坐标
				u32 num:数值(0~999999999);	 
				u8 len:长度(即要显示的位数)
				u8 size:字体大小
				u8 mode:
						[7]:0,不填充;1,填充0.
						[6:1]:保留
						[0]:0,非叠加显示;1,叠加显示.
*/
void LCD_ShowxNum(u16 x,u16 y,u32 num,u8 len,u8 size,u8 mode)
{  
	u8 t,temp;
	u8 enshow=0;						   
	for(t=0;t<len;t++)
	{
		temp=(num/LCD_Pow(10,len-t-1))%10;
		if(enshow==0&&t<(len-1)){
			if(temp==0){
				if(mode&0X80)LCD_ShowChar(x+(size/2)*t,y,'0',size,mode&0X01);  
				else LCD_ShowChar(x+(size/2)*t,y,' ',size,mode&0X01);  
 				continue;
			}else 
				enshow=1; 
		}
	 	LCD_ShowChar(x+(size/2)*t,y,temp+'0',size,mode&0X01); 
	}
} 

/*
	函数功能：显示字符串
	参数：u16 x,u16 y:起点坐标
				u16 width, u16height:区域大小  
				u8 size:字体大小
				u8 *p:字符串起始地址
*/
void LCD_ShowString(u16 x,u16 y,u16 width,u16 height,u8 size,u8 *p)
{         
	u8 x0=x;
	
	width += x;
	height += y;
	
  while((*p<='~')&&(*p>=' ')){ //判断是不是非法字符!
     if(x>=width){
			x = x0;
			y += size;
		 }
     if(y>=height)							//退出
			 break;	
     LCD_ShowChar(x,y,*p,size,0);
     x += size/2;
     p ++;
  }  
}

/*
	函数功能：显示一个指定大小的汉字
	参数：u16 x,u16 y :汉字的坐标
				u8 *dzk:汉字GBK码
				u8 size:字体大小
*/
void Show_Font(u16 x,u16 y,u8 *dzk,u8 size)
{
	u8 temp,t,t1;
	u16 x0 = x;	
  u8 csize = (size/8+((size%8)?1:0))*(size);//得到字体一个字符对应点阵集所占的字节数  
	
	for(t=0;t<csize;t++){   												   
		temp = dzk[t];                       
		for(t1=0;t1<8;t1++){
			if(temp&0x80)
				LCD_DrawPoint(x,y);
			else{
				 LCD_DrawPoint_color(x,y,0xffff);
			}
			temp <<= 1;
			x ++;
			if((x-x0)==size){
				x = x0;
				y ++;
				break;
			}
		}  		 
	}    
}

/*
	函数功能：显示图片：240x320
	参数：*p图片地址
*/
void LCD_Pic(const unsigned char * p)
{
	int x,y;	
	
	LCD_SetCursor(0x00,0x0000);	//设置光标位置 
	LCD_WriteRAM_Prepare();     //开始写入GRAM	 	  
	
	for(y=0;y<320;y++){
    for(x=0;x<240;x++){
			LCD_WR_DATA((*p<<8)|(*(p+1)));
			p += 2;			
    }			
	}
} 

/*******************************************************
自定义显示图片大小
参数：(图片起始横坐标，图片起始纵坐标，图片横像素，图片纵像素，要显示的图片首地址)
********************************************************/
void show_picture(u32 x,u32 y,u32 x1,u32 x2,const unsigned char * p)
{ 
  u32 x0,y0;   
	for(y0=0;y0<x2;y0++){ 
		for(x0=0;x0<x1;x0++){ 
			LCD_Fast_DrawPoint(x+x0,y+y0,(*p<<8)+*(p+1)); //画点
			p += 2;
		}
	}
}

/*
	函数功能：圆心画直线
	参数：int x 圆心横坐标，
				int y 圆心纵坐标，
				int r 半径，直线的长度
				int du 度数
				int color 画点颜色
*/
void Draw_Circle_Line(int x,int y,int r,int du,int color)
{
	int a,b;
	float k;
	k = (du-90)*(3.14159/180);		//转换成弧度制
	a = cos(k)*r;									//求出x轴坐标偏移
	b = sin(k)*r;									//求出y轴坐标偏移
	POINT_COLOR = color;					//设置画点颜色
	LCD_DrawLine(x,y,x+a,y+b);		//调用画线函数
}

/*
	函数功能：画带颜色的能自定义粗的圆
	参数：int x 圆心横坐标，
				int y 圆心纵坐标，
				int r 半径，直线的长度
				int q 圈数
				int color 画点颜色
*/
void Draw_Circles(int x,int y,int r,int q,int color)
{
	while(q--)
		Draw_Circle(x,y,r+q,color);			//画圆
}

/*
	函数功能：以圆圈的自由角度画虚点
	参数：int x 圆心横坐标，
				int y 圆心纵坐标，
				int r 半径，直线的长度
				int q 圈数
				int du 角度
				int color 画点颜色
*/
void Draw_Circle_Dot(int x,int y,int r,int q,int du,int color)
{
	int a=0,b=0;
	float k;
	POINT_COLOR = color;								//设置画点颜色				
	k = (du-90)*(3.14159/180);					//转换成弧度制
	a = cos(k) * r;											//求出x轴坐标偏移
	b = sin(k) * r;											//求出y轴坐标偏移
	Draw_Circles(x+a,y+b,0,q,color);//画小点	
}

/*
	函数功能：画矩形并填充颜色
*/
void LCD_DrawRecFill(u16 x0, u16 y0, u16 x1, u16 y1,u16 color)
{
	LCD_Fill(x0, y0, x1, y1,color);
	LCD_DrawRectangle(x0, y0, x1, y1);		   			//画矩形
}



/*
	说明：常用ASCII表
				偏移量32
				ASCII字符集
				偏移量32
				大小:12*6
*/
const unsigned char ASCII_12[95][12]={
{0x00,0x00,0x00,0x00,0x00,0x00,0x00,0x00,0x00,0x00,0x00,0x00},/*" ",0*/
{0x00,0x00,0x00,0x00,0x3F,0x40,0x00,0x00,0x00,0x00,0x00,0x00},/*"!",1*/
{0x00,0x00,0x30,0x00,0x40,0x00,0x30,0x00,0x40,0x00,0x00,0x00},/*""",2*/
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{0x40,0x00,0x80,0x00,0x40,0x00,0x20,0x00,0x20,0x00,0x40,0x00},/*"~",94*/
}; 
const unsigned char ASCII_16[95][16]={	  
{0x00,0x00,0x00,0x00,0x00,0x00,0x00,0x00,0x00,0x00,0x00,0x00,0x00,0x00,0x00,0x00},/*" ",0*/
{0x00,0x00,0x00,0x00,0x00,0x00,0x1F,0xCC,0x00,0x0C,0x00,0x00,0x00,0x00,0x00,0x00},/*"!",1*/
{0x00,0x00,0x08,0x00,0x30,0x00,0x60,0x00,0x08,0x00,0x30,0x00,0x60,0x00,0x00,0x00},/*""",2*/
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{0x00,0x00,0x60,0x00,0x80,0x00,0x80,0x00,0x40,0x00,0x40,0x00,0x20,0x00,0x20,0x00},/*"~",94*/
}; 

